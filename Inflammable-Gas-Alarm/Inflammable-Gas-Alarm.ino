#include <SPI.h>
#include <Wire.h>
#include <Adafruit_GFX.h>
#include <Adafruit_SSD1306.h>
#include <stdio.h>
#include <string.h>
#include <WiFi.h>
#include <HTTPClient.h>
#include <WebServer.h>
#include <EEPROM.h>
#include <Firebase_ESP_Client.h>
#include "addons/TokenHelper.h"
#include "addons/RTDBHelper.h"
#include "esp_task_wdt.h"

const unsigned char title_main[] PROGMEM = {
    0x00, 0x00, 0x00, 0x00, 0x00, 0x00, 0x00, 0x00, 0x00, 0x00, 0x00, 0x00, 0x00, 0x00, 0x00, 0x00,
    0x00, 0x00, 0x00, 0x00, 0x00, 0x00, 0x00, 0x00, 0x00, 0x00, 0x00, 0x00, 0x00, 0x00, 0x00, 0x00,
    0x00, 0x00, 0x00, 0x00, 0x00, 0x00, 0x00, 0x00, 0x00, 0x00, 0x00, 0x00, 0x00, 0x00, 0x00, 0x00,
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    0x00, 0x00, 0x00, 0x00, 0x00, 0x00, 0x00, 0x00, 0x00, 0x00, 0x00, 0x00, 0x00, 0x00, 0x00, 0x00};

const unsigned char by[] PROGMEM = {
    0x00, 0x00, 0x00, 0x00, 0x00, 0x00, 0x00, 0x00, 0x00, 0x00, 0x00, 0x00, 0x00, 0x00, 0x00, 0x00,
    0x00, 0x00, 0x00, 0x00, 0x00, 0x00, 0x00, 0x00, 0x00, 0x00, 0x00, 0x00, 0x00, 0x00, 0x00, 0x00,
    0x00, 0x00, 0x00, 0x00, 0x00, 0x00, 0x00, 0x00, 0x00, 0x00, 0x00, 0x00, 0x00, 0x00, 0x00, 0x00,
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    0x00, 0x00, 0x00, 0x00, 0x00, 0x00, 0x00, 0x00, 0x00, 0x00, 0x00, 0x00, 0x00, 0x00, 0x00, 0x00};

const unsigned char gauge_no_wifi[] PROGMEM = {
    0x00, 0x00, 0x00, 0x00, 0x00, 0x00, 0x00, 0x00, 0x00, 0x00, 0x00, 0x00, 0x00, 0x00, 0x00, 0x00,
    0x00, 0x00, 0x00, 0x01, 0xdc, 0x00, 0x00, 0x00, 0x00, 0x00, 0x00, 0x00, 0x00, 0x00, 0x00, 0x00,
    0x00, 0x00, 0x00, 0x01, 0x14, 0x00, 0x00, 0x00, 0x00, 0x00, 0x00, 0x00, 0x00, 0x00, 0x00, 0x00,
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    0x00, 0x00, 0x00, 0x00, 0x00, 0x00, 0x00, 0x00, 0x00, 0x00, 0x00, 0x00, 0x00, 0x00, 0x00, 0x00};

const unsigned char gauge_wifi[] PROGMEM = {
    0x00, 0x00, 0x00, 0x00, 0x00, 0x00, 0x00, 0x00, 0x00, 0x00, 0x00, 0x00, 0x00, 0x00, 0x03, 0xf0,
    0x00, 0x00, 0x00, 0x01, 0xdc, 0x00, 0x00, 0x00, 0x00, 0x00, 0x00, 0x00, 0x00, 0x00, 0x04, 0x08,
    0x00, 0x00, 0x00, 0x01, 0x14, 0x00, 0x00, 0x00, 0x00, 0x00, 0x00, 0x00, 0x00, 0x00, 0x09, 0xe4,
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    0x00, 0x00, 0x00, 0x00, 0x00, 0x00, 0x00, 0x00, 0x00, 0x00, 0x00, 0x00, 0x00, 0x00, 0x00, 0x00};




int Sensor_input = 35;
#define BUZZER 13
int FAN = 18;
int SIREN = 19;




#define SCREEN_WIDTH 128
#define SCREEN_HEIGHT 64
#define OLED_RESET - 1
int statusCode;
Adafruit_SSD1306 display(SCREEN_WIDTH, SCREEN_HEIGHT, & Wire, OLED_RESET);
int CALIBARAION_SAMPLE_TIMES = 50;
int CALIBRATION_SAMPLE_INTERVAL = 70;



int needle_angle_deg = 45;
int needle_start_x;
int needle_start_y;
int needle_end_x;
int needle_end_y;
int needle_center_x = 33;
int needle_center_y = 38;

int needle_radius_big = 25;
int needle_radius_small = 10;

int needle_offset_x;
int needle_offset_y;
const char * ssid = "text";
const char * password = "text";

String DeviceId;
String calibration_sting;
String content;
WiFiServer server(80);
int status;
WebServer host(80);




#define API_KEY "YOUR_API_KEY"
#define DATABASE_URL "YOUR_DATABASE_URL"

FirebaseData fbdo, fbdo_s1, fbdo_s2;
FirebaseAuth auth;
FirebaseConfig config;

int sensor_data = 0;

bool signupOK = false;
int previous_data = 0;
unsigned long sendDataPrevMillis = 0;

bool testWifi(void);
void launchWeb(void);
void setupAP(void);
#define EEPROM_SIZE 4096





TaskHandle_t different_loop_task;

esp_task_wdt_config_t wdt_config = {
  .timeout_ms = 3000,
  .idle_core_mask = (1 << portNUM_PROCESSORS) - 1,
  .trigger_panic = false
};



void different(void * pvParameters) {
  setup_different();
  for (;;) {
    loop_different();
  }
}

void setup_different(void) {
  pinMode(FAN, OUTPUT);
  pinMode(SIREN, OUTPUT);

  esp_task_wdt_deinit();
  esp_task_wdt_init( & wdt_config);
  esp_task_wdt_add(NULL);
  config.api_key = API_KEY;
  config.database_url = DATABASE_URL;

  if (Firebase.signUp( & config, & auth, "", "")) {
    signupOK = true;
  } else {
    Serial.printf("%s\n", config.signer.signupError.message.c_str());
  }
  config.token_status_callback = tokenStatusCallback;
  Firebase.begin( & config, & auth);

  if (!Firebase.RTDB.beginStream( & fbdo_s1, DeviceId + "/Sensor/ES/exhaust")) {
    Serial.println("Failed to begin stream: " + fbdo.errorReason());
  }
  if (!Firebase.RTDB.beginStream( & fbdo_s2, DeviceId + "/Sensor/ES/siren")) {
    Serial.println("Failed to begin stream: " + fbdo.errorReason());
  }
}

void loop_different() {
  esp_task_wdt_reset(); // Reset the watchdog timer to prevent a reset

  // Check if Firebase is ready, signup is successful, and status is 3
  if (Firebase.ready() && signupOK && WiFi.status() == 3 && (millis() - sendDataPrevMillis > 500 || sendDataPrevMillis == 0)) {
    if (sensor_data != previous_data) {

      if (Firebase.RTDB.setInt( & fbdo, DeviceId + "/Sensor/data", sensor_data)) {
        previous_data = sensor_data;
        Serial.println("Sensor data updated successfully");
      } else {
        Serial.println("Failed to update sensor data: " + fbdo.errorReason());
      }
      sendDataPrevMillis = millis();
    }
  }
  if (Firebase.ready() && signupOK && WiFi.status() == 3) {
    // Get exhaust value from Firebase and control the FAN accordingly
    if (!Firebase.RTDB.readStream( & fbdo_s1))
      Serial.println("Failed to read stream 1: " + fbdo_s1.errorReason());
    if (fbdo_s1.streamAvailable()) {
      int exhaustValue = fbdo_s1.intData();
      Serial.println("Exhaust value: " + exhaustValue);
      digitalWrite(FAN, exhaustValue == 1 ? HIGH : LOW);
    }

    // Get siren value from Firebase and control the SIREN accordingly
    if (!Firebase.RTDB.readStream( & fbdo_s2))
      Serial.println("Failed to read stream 2: " + fbdo_s2.errorReason());
    if (fbdo_s2.streamAvailable()) {
      int sirenValue = fbdo_s2.intData();
      digitalWrite(SIREN, sirenValue == 1 ? HIGH : LOW);
    }
  }
}

void setup() {
  Serial.begin(115200);
  EEPROM.begin(EEPROM_SIZE);

  pinMode(BUZZER, OUTPUT);

  tone(BUZZER, 2000);

  delay(100);

  noTone(BUZZER);
  // SSD1306_SWITCHCAPVCC = generate display voltage from 3.3V internally
  if (!display.begin(SSD1306_SWITCHCAPVCC, 0x3C)) {
    Serial.println(F("SSD1306 allocation failed"));
    for (;;)
    ; // Don't proceed, loop forever
  }

  // EEPROM HANDLES
  int offset = 0; // Initialize the offset to keep track of the position in EEPROM

  // Read and print data from EEPROM
  String uName = readAndPrintEEPROMData(offset, "uName");
  String uEmail = readAndPrintEEPROMData(offset, "uEmail");
  String uPass = readAndPrintEEPROMData(offset, "uPass");
  String deviceId = readAndPrintEEPROMData(offset, "deviceId");
  String qSid = readAndPrintEEPROMData(offset, "qsid");
  String qPass = readAndPrintEEPROMData(offset, "qpass");
  DeviceId = deviceId;

  WiFi.begin(qSid.c_str(), qPass.c_str());

  if (testWifi()) {
    Serial.println("Succesfully Connected!!!");

    tone(BUZZER, 2000);

    delay(100);

    noTone(BUZZER);
    intro_start();
    delay(4000);
    intro_by();
    delay(1000);
    MQCalibration(Sensor_input);
    delay(2000);

    xTaskCreatePinnedToCore(
      different,
      "different_loop",
      10000,
      NULL,
      1, &
      different_loop_task,
      !ARDUINO_RUNNING_CORE);
    return;
  } else {
    Serial.println("Turning the HotSpot On");

    display.clearDisplay();
    display.setCursor(0, 0);

    display.print(F("Failed to connect to WiFi. Tuning on Hotspot ..."));
    display.display();
    delay(1000);
    launchWeb();
    setupAP(); // Setup HotSpot
  }

  while ((WiFi.status() != WL_CONNECTED)) {
    Serial.print("~");
    delay(100);
    host.handleClient();
  }
}

void loop() {
  int sensor_Aout = analogRead(Sensor_input); /*Analog value read function*/
  display.display();
  sensor_Aout = map(sensor_Aout, 0, 4090, 0, 100);
  sensor_data = sensor_Aout;

  needle_angle_deg = map(sensor_Aout, 0, 100, 45, 263 + 45);

  if (sensor_Aout >= 50) {
    gauge(sensor_Aout);
    tone(BUZZER, 2000);
  } else {
    gauge(sensor_Aout);
    noTone(BUZZER);
  }

  if (Serial.available() > 0) {
    String command = Serial.readStringUntil('\n');
    if (command == "CLEAR_EEPROM") {
      clearEEPROM();
      Serial.println("EEPROM cleared.");
    }
  }
  delay(100);
}

void testdrawstyles(int num) {
  char snum[5];

  itoa(num, snum, 10);
  display.setCursor(73, 24);
  display.setTextSize(3);
  display.setTextColor(WHITE);
  display.print(F(snum));
  display.display();
}

void intro_by(void) {
  display.clearDisplay();
  display.drawBitmap(0, 0, by, 128, 64, WHITE);
  display.display();
}
void intro_start(void) {
  display.clearDisplay();
  display.drawBitmap(0, 0, title_main, 128, 64, WHITE);
  display.display();
}
void gauge(int sensor_Aout) {
  display.clearDisplay();
  status = WiFi.status();
  if (status == 3) {
    display.drawBitmap(0, 0, gauge_wifi, 128, 64, WHITE);
  } else {
    display.drawBitmap(0, 0, gauge_no_wifi, 128, 64, WHITE);
  }

  needle_start_x = needle_radius_big * -sin(radians(needle_angle_deg)) + needle_center_x;
  needle_start_y = needle_radius_big * cos(radians(needle_angle_deg)) + needle_center_y;

  needle_end_x = needle_radius_small * -sin(radians(needle_angle_deg + 180)) + needle_center_x;
  needle_end_y = needle_radius_small * cos(radians(needle_angle_deg + 180)) + needle_center_y;
  if ((needle_angle_deg > 45 && needle_angle_deg < 135) || (needle_angle_deg > 225 && needle_angle_deg < 315)) {
    needle_offset_x = 0;
    needle_offset_y = 1;
  } else {
    needle_offset_x = 1;
    needle_offset_y = 0;
  }

  display.drawLine(needle_start_x, needle_start_y, needle_end_x, needle_end_y, WHITE);
  display.drawLine(needle_start_x + needle_offset_x, needle_start_y + needle_offset_y, needle_end_x + needle_offset_x, needle_end_y + needle_offset_y, WHITE);
  testdrawstyles(sensor_Aout);

  display.display();
}

void MQCalibration(int mq_pin) {
  int i;
  float val = 0;
  char dot[10] = ".";
  for (i = 0; i < CALIBARAION_SAMPLE_TIMES; i++) {
    Serial.println(analogRead(mq_pin));
    tone(BUZZER, 2000);
    delay(30);
    noTone(BUZZER);
    strcat(dot, ".");
    if (i % 5 == 0) {
      strcpy(dot, "");
    }

    delay(400 + CALIBRATION_SAMPLE_INTERVAL);
    display.clearDisplay();

    display.setCursor(0, 0);
    display.setTextSize(2);
    display.setTextColor(WHITE);
    char calibration_sting[15] = "Calib";
    strcat(calibration_sting, dot);

    display.print(F(calibration_sting));
    display.display();
  }

  tone(BUZZER, 2000);
  display.clearDisplay();
  display.setCursor(0, 0);
  display.setTextSize(2);

  display.print(F("Calibrated"));
  display.setCursor(0, 25);
  display.setTextSize(2);
  char result_wifi[] = "WiFi : Succesfully Connected!";
  status = WiFi.status();

  if (status == 1) {
    strcpy(result_wifi, "WiFi : Not Found");
  } else if (status == 3) {
    strcpy(result_wifi, "WiFi : Ok");
  } else if (status == 4) {
    strcpy(result_wifi, "WiFi : Failed");
  }
  display.print(F(result_wifi));
  display.display();
  delay(1000);
  noTone(BUZZER);
  delay(2000);
}
bool testWifi(void) {
  int c = 0;
  Serial.println("Waiting for Wifi to connect");
  display.clearDisplay();
  display.setCursor(0, 0);

  display.print(F("Connecting WiFi ..."));
  display.display();
  while (c < 20) {
    if (WiFi.status() == WL_CONNECTED) {
      return true;
    }
    delay(500);
    Serial.print("*");
    c++;
  }
  Serial.println("");
  Serial.println("Connect timed out, opening AP");

  return false;
}

void launchWeb() {
  Serial.println("");
  if (WiFi.status() == WL_CONNECTED)
    Serial.println("WiFi connected");
  Serial.print("Local IP: ");
  Serial.println(WiFi.localIP());
  Serial.print("SoftAP IP: ");
  Serial.println(WiFi.softAPIP());
  display.clearDisplay();

  display.setCursor(0, 0);
  createWebServer();
  // Start the host
  host.begin();
  Serial.println("Server started");
  display.print("OPEN THE MOBILE APP AND FOLLOW THE INSTRUCTIONS TO SET-UP THIS DEVICE");
  display.display();
}

void setupAP(void) {
  WiFi.mode(WIFI_STA);
  WiFi.disconnect();
  WiFi.softAP("GasAlert-xyz", "", 1, 0);
  launchWeb();
}

void createWebServer() {
  {
    host.on("/setting", []() {
      String qsid = host.arg("ssid");
      String qpass = host.arg("pass");
      String uName = host.arg("username");
      String uEmail = host.arg("email");
      String uPass = host.arg("userPassword");
      if (qsid.length() > 0 && qpass.length() > 0) {
        Serial.println("clearing eeprom");
        display.clearDisplay();
        display.setCursor(0, 0); // Start at top-left corner //was at 40
        display.print(F("Clearing EEPROM")); // add dots
        for (int i = 0; i < 96; ++i) {
          EEPROM.write(i, 0);
        }
        
        String deviceId = generateDeviceID();

        int currentIndex = 0;

        // Write data to EEPROM
        EEPROM.write(currentIndex, uName.length());
        currentIndex += sizeof(int); // Update the offset to the next position
        for (int i = 0; i < uName.length(); ++i) {
          EEPROM.write(currentIndex + i, uName[i]);
        }
        currentIndex += uName.length();

        EEPROM.write(currentIndex, uEmail.length());
        currentIndex += sizeof(int); // Update the offset to the next position
        for (int i = 0; i < uEmail.length(); ++i) {
          EEPROM.write(currentIndex + i, uEmail[i]);
        }
        currentIndex += uEmail.length();

        EEPROM.write(currentIndex, uPass.length());
        currentIndex += sizeof(int); // Update the offset to the next position
        for (int i = 0; i < uPass.length(); ++i) {
          EEPROM.write(currentIndex + i, uPass[i]);
        }
        currentIndex += uPass.length();

        EEPROM.write(currentIndex, deviceId.length());
        currentIndex += sizeof(int); // Update the offset to the next position
        for (int i = 0; i < deviceId.length(); ++i) {
          EEPROM.write(currentIndex + i, deviceId[i]);
        }
        currentIndex += deviceId.length();

        EEPROM.write(currentIndex, qsid.length());
        currentIndex += sizeof(int); // Update the offset to the next position
        for (int i = 0; i < qsid.length(); ++i) {
          EEPROM.write(currentIndex + i, qsid[i]);
        }
        currentIndex += qsid.length();

        EEPROM.write(currentIndex, qpass.length());
        currentIndex += sizeof(int); // Update the offset to the next position
        for (int i = 0; i < qpass.length(); ++i) {
          EEPROM.write(currentIndex + i, qpass[i]);
        }

        EEPROM.commit();

        content = "{\"Success\":\"" + deviceId + "\"}";
        statusCode = 200;

        host.sendHeader("Access-Control-Allow-Origin", "*");
        host.send(statusCode, "application/json", content);
        Serial.println(content);
        delay(5000);

        ESP.restart();
      } else {
        content = "{\"Error\":\"500 Error\"}";
        statusCode = 500;
        Serial.println("Sending 500");

        host.sendHeader("Access-Control-Allow-Origin", "*");
        host.send(statusCode, "application/json", content);
      }
    });
  }
}

String readAndPrintEEPROMData(int & offset,
  const char * label) {
  int dataLength = EEPROM.read(offset); // Read the length of data
  offset += sizeof(int); // Move to the next position for data

  String data;
  for (int i = 0; i < dataLength; ++i) {
    data += char(EEPROM.read(offset + i));
  }
  offset += dataLength; // Move to the next position after reading data
  return data;
}

String generateDeviceID() {
  uint8_t mac[6];
  WiFi.macAddress(mac);

  String macID = "";
  for (int i = 0; i < 6; i++) {
    macID += String(mac[i], HEX);
    if (i < 5)
      macID += ":";
  }

  macID += "-";
  macID += random(1000); // Add a random 3-digit number

  return macID;
}

void clearEEPROM() {
  for (int i = 0; i < EEPROM.length(); i++) {
    EEPROM.write(i, 0);
  }
  EEPROM.commit();
}



void writeStringToEEPROM(int & currentIndex,
  const String & data) {
  uint8_t length = data.length();
  EEPROM.write(currentIndex++, length);
  for (int i = 0; i < length; ++i) {
    EEPROM.write(currentIndex++, data[i]);
  }
}



